// SPDX-License-Identifier: (GPL-2.0 OR MIT)
/*
 * Copyright (C) 2025 Synaptics Incorporated
 *
 * Author: Jisheng Zhang <jszhang@kernel.org>
 */

/dts-v1/;

#include "sl2615.dtsi"
#include "sl2610-rdk-common.dtsi"

/ {
	model = "Synaptics SL2615 RDK";
	compatible = "syna,sl2615-rdk", "syna,sl2615";
};
