## arch/arm/mach-synaptics/Kconfig
```kconfig
if ARCH_SYNAPTICS

config SYS_SOC
	default "synaptics"

config SYS_VENDOR
	default "synaptics"

config SYNAPTICS_SL2619
	bool "Synaptics SL2619 SoC"
	select ARM64
	help
	  The Synaptics SL2619 is a ARM64-based SoC with a dual-core Cortex-A55.
	  including UART, SPI, USB2.0 and OTG, EMMC, etc.

config SYNAPTICS_REGMEM_MAP_BASE
	hex
	default 0xe0000000 if SYNAPTICS_SL2619

config SYNAPTICS_REGMEM_MAP_SIZE
	hex
	default 0x20000000 if SYNAPTICS_SL2619

if SYNAPTICS_SL2619

config TARGET_SL2619
	bool "Support Synaptics SL2619 RDK board"
	help
	  Support for the Synaptics Astra Machina SL2619 RDK board based on the
	  Synaptics SL2619 SoC.

source "board/synaptics/sl2619/Kconfig"

endif

endif
```

## board/synaptics/sl2619/Kconfig
```kconfig
if TARGET_SL2619

config SYS_BOARD
	default "sl2619"

config SYS_CONFIG_NAME
	default "synaptics_sl2619"

endif
```

## configs/synaptics_sl2619_defconfig
```kconfig
CONFIG_ARM=y
CONFIG_POSITION_INDEPENDENT=y
# CONFIG_ARM64_SUPPORT_AARCH32 is not set
CONFIG_ARCH_SYNAPTICS=y
CONFIG_BOARD_EARLY_INIT_F=y
CONFIG_SYS_MALLOC_LEN=0x5aa00000
CONFIG_NR_DRAM_BANKS=1
CONFIG_ENV_SIZE=0x10000
CONFIG_DEFAULT_DEVICE_TREE="synaptics/sl2619-rdk"
CONFIG_OF_LIBFDT_OVERLAY=y
CONFIG_DM_RESET=y
CONFIG_SYS_BOOTM_LEN=0x4000000
CONFIG_SYS_LOAD_ADDR=0xcf00000
CONFIG_WATCHDOG_TIMEOUT_MSECS=0
CONFIG_TARGET_SL2619=y
CONFIG_BOOTSTD=y
CONFIG_SUPPORT_RAW_INITRD=y
CONFIG_BOOTDELAY=0
# CONFIG_ARCH_FIXUP_FDT_MEMORY is not set
CONFIG_DEFAULT_FDT_FILE="sl2619-rdk.dtb"
# CONFIG_DISPLAY_CPUINFO is not set
# CONFIG_BOARD_INIT is not set
CONFIG_HUSH_PARSER=y
# CONFIG_BOOTM_PLAN9 is not set
# CONFIG_BOOTM_RTEMS is not set
# CONFIG_BOOTM_VXWORKS is not set
# CONFIG_CMD_XIMG is not set
# CONFIG_CMD_EXPORTENV is not set
CONFIG_CMD_NVEDIT_INFO=y
# CONFIG_CMD_LZMADEC is not set
CONFIG_CMD_I2C=y
# CONFIG_CMD_LOADS is not set
# CONFIG_CMD_ITEST is not set
# CONFIG_CMD_SOURCE is not set
# CONFIG_CMD_SETEXPR is not set
CONFIG_CMD_CACHE=y
CONFIG_CMD_TIMER=y
CONFIG_OF_CONTROL=y
CONFIG_OF_UPSTREAM=y
CONFIG_ENV_VARS_UBOOT_RUNTIME_CONFIG=y
CONFIG_VERSION_VARIABLE=y
# CONFIG_NET is not set
CONFIG_SYSCON=y
CONFIG_BOUNCE_BUFFER=y
CONFIG_CLK=y
CONFIG_CLK_SL261X=y
# CONFIG_GPIO is not set
CONFIG_DM_I2C=y
CONFIG_SYS_I2C_DW=y
CONFIG_MISC=y
# CONFIG_MMC is not set
CONFIG_PINCTRL=y
CONFIG_PINCTRL_SL261X=y
CONFIG_SPECIFY_CONSOLE_INDEX=y
CONFIG_DM_SERIAL=y
CONFIG_SERIAL_RX_BUFFER=y
CONFIG_SYSRESET=y
CONFIG_SYSRESET_PSCI=y
# CONFIG_OPTEE_LIB is not set
# CONFIG_TOOLS_LIBCRYPTO is not set
# CONFIG_TOOLS_KWBIMAGE is not set
```

## drivers/clk/synaptics/Kconfig
```kconfig
config CLK_SL2610
	bool "Synaptics SL2610 clock driver"
	depends on CLK && ARCH_SYNAPTICS
	depends on SYSCON
	select CLK_CCF
	select CLK_AUTO_ID
	help
	  This enables support for clock driver for SL2610 Synaptics SoCs.
	  The driver handles clocks from soc, cpu, aio and system manager
	  domains.
	  The clock controller generates and supplies clocks to various
	  peripherals within the SoC.
```
